; --------------------------------------------------------------------------------
; @Title: Example for flash declaration of Nordic Semiconductor NRF51 internal flash. 
; 
; @Description: 
; Script arguments:
;
;   DO nrf51 [PREPAREONLY]
;
;     PREPAREONLY only declares flash but does not execute flash programming
;
; Example:
;
;   DO ~~/demo/arm/flash/nrf51 PREPAREONLY
;
; List of NRF51 derivatives and their configuration:
;
;   CPU-Type        Flash size   Page size   SRAM size
;                     (kB)         (Byte)       (kB)
; ------------------------------------------------------------------------------
;   nRF51422-QFAA     256          1024          16        
;   nRF51422-CEAA     256          1024          16     
;   nRF51422-QFAB     128          1024          16     
;   nRF51422-CDAB     128          1024          16     
;   nRF51422-QFAC     256          1024          32     
;   nRF51422-CFAC     256          1024          32  
;   nRF51822-QFAA     256          1024          16        
;   nRF51822-CEAA     256          1024          16     
;   nRF51822-QFAB     128          1024          16     
;   nRF51822-CDAB     128          1024          16     
;   nRF51822-QFAC     256          1024          32     
;   nRF51822-CFAC     256          1024          32     
;
; @Author: FLC
; @Copyright: (C) 1989-2015 Lauterbach GmbH, licensed for use with TRACE32(R) only
; @Chip: NRF51*
; --------------------------------------------------------------------------------
; $Rev: 3170 $
; $Id: nrf51.cmm 3170 2015-02-16 07:35:59Z fcaron $

sys.down

  LOCAL &parameters &param_prepareonly
  ENTRY %LINE &parameters
  &param_prepareonly=(STRing.SCAN(STRing.UPpeR("&parameters"),"PREPAREONLY",0)!=-1)

  LOCAL &flashsize
  
  ; ------------------------------------------------------------------------------
  ; Setup CPU

  IF SYStem.MODE()<5
  (
    SYStem.RESet
    SYStem.CPU NRF51822
    SYStem.JtagClock 1Mhz
    SYStem.Up
  )

data.load.elf ../obj/ble_app_beacon_s110_xxaa.elf /nocode

go main

do win.cmm

  ENDDO
