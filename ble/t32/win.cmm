// T32 Fri Aug 14 13:21:20 2015

 B::
 
 TOOLBAR ON
 STATUSBAR ON
 FramePOS 10.714,6.25,,,Maximized
 WinPAGE.RESet
 
 WinPAGE.Create P000
 
 WinCLEAR
 WinPOS 0.28571 0.0 97. 35. 16. 1. W000
 WinTABS 10. 10. 25. 62.
 List.auto
 
 WinPOS 102.14 13.667 66. 25. 5. 0. W001
 Frame.view /Locals /Caller
 
 WinPOS 102.86 0.0 48. 9. 0. 0. W002
 Register.view /sl
 
 WinPAGE.select P000
 
 ENDDO
